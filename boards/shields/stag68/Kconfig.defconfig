## config/boards/shields/handwired_68/Kconfig.defconfig
```kconfig
if SHIELD_HANDWIRED_68
config ZMK_KEYBOARD_NAME
    default "handwired_68"
endif
```

## config/boards/shields/handwired_68/Kconfig.shield
```kconfig
# Custom shield config (optional)
menu "Handwired 68 Shield Configuration"

config SHIELD_HANDWIRED_68
    bool "Enable handwired 68 keyboard"
    default y

# Add other config options here if needed
# config MY_CUSTOM_OPTION
#     bool "Enable custom thing"

endmenu
```
