/ {
    chosen {
        zmk,kscan = &kscan0;
    };

    kscan0: kscan {
        compatible = "zmk,kscan-gpio-matrix";
        label = "KSCAN";

        row-gpios = <&gpio0 6   GPIO_ACTIVE_LOW>,
                    <&gpio0 17  GPIO_ACTIVE_LOW>,
                    <&gpio0 8   GPIO_ACTIVE_LOW>,
                    <&gpio0 20  GPIO_ACTIVE_LOW>,
                    <&gpio0 22  GPIO_ACTIVE_LOW>,
                    <&gpio0 100 GPIO_ACTIVE_LOW>,
                    <&gpio0 11  GPIO_ACTIVE_LOW>,
                    <&gpio0 104 GPIO_ACTIVE_LOW>,
                    <&gpio0 106 GPIO_ACTIVE_LOW>,
                    <&gpio0 101 GPIO_ACTIVE_LOW>,
                    <&gpio0 102 GPIO_ACTIVE_LOW>,
                    <&gpio0 107 GPIO_ACTIVE_LOW>,
                    <&gpio0 600 GPIO_ACTIVE_LOW>,
                    <&gpio0 10  GPIO_ACTIVE_LOW>;

        col-gpios = <&gpio0 111 GPIO_ACTIVE_LOW>,
                    <&gpio0 113 GPIO_ACTIVE_LOW>,
                    <&gpio0 115 GPIO_ACTIVE_LOW>,
                    <&gpio0 2   GPIO_ACTIVE_LOW>,
                    <&gpio0 29  GPIO_ACTIVE_LOW>;

        diode-direction = "row2col";

        debounce-press-ms = <5>;
        debounce-release-ms = <5>;
    };

    &zmk {
        compatible = "zmk,ks-settings";
    };
};
